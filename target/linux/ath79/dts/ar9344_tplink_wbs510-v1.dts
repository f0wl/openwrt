// SPDX-License-Identifier: GPL-2.0-or-later OR MIT
/dts-v1/;

#include <dt-bindings/gpio/gpio.h>
#include <dt-bindings/input/input.h>

#include "ar9344_tplink_wbs.dtsi"

/ {
	compatible = "tplink,wbs510-v1", "qca,ar9344";
	model = "TP-Link WBS510 v1";
};
