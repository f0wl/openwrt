// SPDX-License-Identifier: GPL-2.0-or-later OR MIT
/dts-v1/;

#include <dt-bindings/gpio/gpio.h>
#include <dt-bindings/input/input.h>

#include "ar9344_tplink_cpe.dtsi"

/ {
	compatible = "tplink,cpe510-v1", "qca,ar9344";
	model = "TP-Link CPE510 v1";
};
